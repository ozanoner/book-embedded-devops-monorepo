## ch05/button-app/sdkconfig.defaults
```kconfig
CONFIG_LIBC_NEWLIB=y
CONFIG_ESP_TASK_WDT_TIMEOUT_S=30
CONFIG_MBEDTLS_DYNAMIC_BUFFER=y
CONFIG_MBEDTLS_DYNAMIC_FREE_CONFIG_DATA=y
CONFIG_ESP_INSIGHTS_ENABLED=y
CONFIG_ESP_INSIGHTS_META_VERSION_10=n
```
